## CMakeLists.txt
```
cmake_minimum_required(VERSION 3.20.0)

find_package(Zephyr REQUIRED HINTS $ENV{ZEPHYR_BASE})

project(bthome_energy)

# Use GLOB to select all .c files in the src directory
file(GLOB SRC_FILES "src/*.c")

# Add the .c files to the target
target_sources(app PRIVATE ${SRC_FILES})
```

## prj.conf
```kconfig
# --- BLE config
CONFIG_BT=y
CONFIG_BT_PERIPHERAL=y
CONFIG_BT_CENTRAL=n
CONFIG_BT_CTLR_TX_PWR_PLUS_4=y
CONFIG_BT_DEVICE_NAME="energy"
CONFIG_BTHOME=y

# --- Sensor config
CONFIG_SENSORS=y

# --- Size optimizations
CONFIG_SIZE_OPTIMIZATIONS=y
CONFIG_ISR_STACK_SIZE=512
# CONFIG_BT_CTLR_RX_STACK_SIZE=512
# CONFIG_BT_CTLR_RX_PRIO_STACK_SIZE=448
CONFIG_BT_HCI_TX_STACK_SIZE_WITH_PROMPT=y
CONFIG_BT_HCI_TX_STACK_SIZE=640
CONFIG_SYSTEM_WORKQUEUE_STACK_SIZE=512
CONFIG_IDLE_STACK_SIZE=128
CONFIG_HEAP_MEM_POOL_SIZE=512

# CONFIG_CBPRINTF_FP_SUPPORT=y
# CONFIG_PRINTK=y
```

## src/main.c
```c
#include <zephyr/kernel.h>
#include <zephyr/drivers/sensor.h>
#include <zephyr/drivers/adc.h>
#include <zephyr/drivers/gpio.h>
#include "bthome.h"
#include "sensors.h"

#define IMP_PER_KWH 1000UL

static bthome_data_array_t bthome_data;
static float energy = 0.0;
static float power = 0.0;
static int64_t last_pulse = 0;

void energy_cb()
{
    int64_t pulse_delta = k_uptime_get() - last_pulse;

    energy += 0.001f;
    power = (float)((3600000000ULL) / IMP_PER_KWH) / (float)pulse_delta;

    printk("[%08d] LED pulse -> energy=%d Wh, power=%d W\n",
           k_uptime_get_32(),
           (int)(energy * 1000),
           (int)power);

    struct batt_t batt;
    sensors_read_battery(&batt);

    bthome_insert_int(&bthome_data, ID_BATTERY, (int)(batt.percentage * 100));
    bthome_insert_float(&bthome_data, ID_ENERGY, energy);

    if (last_pulse > 0)
        bthome_insert_float(&bthome_data, ID_POWER, power);

    bthome_update_advertise(&bthome_data);

    last_pulse = k_uptime_get();
}

int main()
{
    bthome_init(&bthome_data);

    sensors_init_battery();
    sensors_init_energy(energy_cb);

    // printk("Starting BTHome sensor\n");
    printk("Starting BTHome sensor '%s'\n", CONFIG_BT_DEVICE_NAME);

    /* Start advertising */
    bthome_start_advertise(&bthome_data, BTHOME_NO_ENCRYPT_TRIGGER_BASE);

    return 0;
}
```
