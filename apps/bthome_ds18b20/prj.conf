## CMakeLists.txt
```
cmake_minimum_required(VERSION 3.20.0)

find_package(Zephyr REQUIRED HINTS $ENV{ZEPHYR_BASE})

project(bthome_ds18b20)

# Use GLOB to select all .c files in the src directory
file(GLOB SRC_FILES "src/*.c")

# Add the .c files to the target
target_sources(app PRIVATE ${SRC_FILES})
```

## prj.conf
```kconfig
# --- BLE config
CONFIG_BT=y
CONFIG_BT_PERIPHERAL=y
CONFIG_BT_CENTRAL=n
CONFIG_BT_CTLR_TX_PWR_PLUS_4=y
CONFIG_BT_DEVICE_NAME="office"
CONFIG_BTHOME=y
CONFIG_BTHOME_ADVERTISING_INTERVAL_MS=10000

# --- Sensor config
CONFIG_W1=y
CONFIG_SENSORS=y

# --- Size optimizations
CONFIG_SIZE_OPTIMIZATIONS=y
CONFIG_ISR_STACK_SIZE=512
# CONFIG_BT_CTLR_RX_STACK_SIZE=512
# CONFIG_BT_CTLR_RX_PRIO_STACK_SIZE=448
CONFIG_BT_HCI_TX_STACK_SIZE_WITH_PROMPT=y
CONFIG_BT_HCI_TX_STACK_SIZE=640
CONFIG_SYSTEM_WORKQUEUE_STACK_SIZE=512
CONFIG_IDLE_STACK_SIZE=128
CONFIG_HEAP_MEM_POOL_SIZE=512
```

## src/main.c
```c
#include <zephyr/kernel.h>
#include <zephyr/drivers/sensor.h>
#include <zephyr/drivers/gpio.h>

#include "bthome.h"
#include "sensors.h"

int main()
{
    bthome_data_array_t bthome_data;
    bthome_init(&bthome_data);

    sensors_init_battery();

    printk("Starting BTHome sensor '%s'\n", CONFIG_BT_DEVICE_NAME);

    /* Start advertising */
    bthome_start_advertise(&bthome_data, BTHOME_NO_ENCRYPT_TRIGGER_BASE);

    for (;;)
    {
        struct batt_t batt = {0};
        struct sensor_value temp_ds18b20 = {0};

        uint32_t start = k_uptime_get_32();

        if (sensors_read_temperature_ds18b20(&temp_ds18b20) == 0)
        {
            bthome_insert_float(&bthome_data, ID_TEMPERATURE_PRECISE, sensor_value_to_float(&temp_ds18b20));
        }

        sensors_read_battery(&batt);
        bthome_insert_int(&bthome_data, ID_BATTERY, (int)(batt.percentage * 100));

        printk("[%08d] batt = %3d%% temp_ds18b20 = %2d.%02dC\n",
               k_uptime_get_32(),
               (int)(batt.percentage * 100),
               temp_ds18b20.val1, temp_ds18b20.val2 / 10000);

        bthome_update_advertise(&bthome_data);

        uint32_t stop = k_uptime_get_32();
        k_msleep(CONFIG_BTHOME_ADVERTISING_INTERVAL_MS - (stop - start));
    }

    bthome_free(&bthome_data);

    return 0;
}
```
