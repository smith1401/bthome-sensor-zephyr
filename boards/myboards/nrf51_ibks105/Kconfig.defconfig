## boards/myboards/nrf51_ibks105/Kconfig.defconfig
```kconfig
# nRF51 BLENANO board configuration

# Copyright (c) 2016 Nordic Semiconductor ASA
# SPDX-License-Identifier: Apache-2.0

if BOARD_NRF51_IBKS105

config BT_CTLR
	default BT

config UART_CONSOLE
	default CONSOLE

endif # BOARD_NRF51_IBKS105
```

## boards/myboards/nrf51_ibks105/Kconfig.nrf51_ibks105
```kconfig
# Copyright (c) 2016 Linaro Limited.
# SPDX-License-Identifier: Apache-2.0

config BOARD_NRF51_IBKS105
	select SOC_NRF51822_QFAA
```

## boards/myboards/nrf51_ibks105/nrf51_ibks105_defconfig
```kconfig
# SPDX-License-Identifier: Apache-2.0

# enable GPIO
CONFIG_GPIO=y

# Enable RTT
# CONFIG_USE_SEGGER_RTT=y

# enable uart driver
CONFIG_SERIAL=y

# enable console
CONFIG_CONSOLE=y
CONFIG_UART_CONSOLE=y
# CONFIG_RTT_CONSOLE=y
```

## boards/myboards/snes_gamepad_nrf52840/Kconfig
```kconfig
# SNES Gamepad nRF52840 board configuration

# Copyright (c) 2022 Nikola Trifunovic
# Copyright (c) 2018 Nordic Semiconductor ASA
# SPDX-License-Identifier: Apache-2.0

if BOARD_SNES_GAMEPAD_NRF52840

config BOARD_ENABLE_DCDC
	bool "DCDC mode"
	select SOC_DCDC_NRF52X
	default y

config BOARD_ENABLE_DCDC_HV
	bool "High Voltage DCDC converter"
	select SOC_DCDC_NRF52X_HV
	default n

config BOARD_SERIAL_BACKEND_CDC_ACM
	bool "USB CDC"
	default n

endif # BOARD_SNES_GAMEPAD_NRF52840
```

## boards/myboards/snes_gamepad_nrf52840/Kconfig.snes_gamepad_nrf52840
```kconfig
# Copyright (c) 2018 Nordic Semiconductor ASA
# SPDX-License-Identifier: Apache-2.0

config BOARD_SNES_GAMEPAD_NRF52840
	select SOC_NRF52840_QIAA
```

## boards/myboards/snes_gamepad_nrf52840/board.yml
```yaml
board:
  name: snes_gamepad_nrf52840
  vendor: others
  socs:
    - name: nrf52840
```

## lib/bthome/Kconfig
```kconfig
# Copyright (c) 2021 Nordic Semiconductor ASA
# SPDX-License-Identifier: Apache-2.0

config BTHOME
	bool "Libary for advertising BThome packets"

if BTHOME

config BTHOME_ADVERTISING_INTERVAL_MS
	int "Interval in milliseconds for BTHome advertising"
	default 1000

module=BTHOME
module-dep=LOG
module-str=BTHome library
source "${ZEPHYR_BASE}/subsys/logging/Kconfig.template.log_config"

endif # BTHOME
```

## lib/sensors/Kconfig
```kconfig
# Copyright (c) 2021 Nordic Semiconductor ASA
# SPDX-License-Identifier: Apache-2.0

config SENSORS
	bool "Libary for sensor connection"
	select ADC
	select SENSOR
if SENSORS

module=SENSORS
module-dep=LOG
module-str=Sensors library
source "${ZEPHYR_BASE}/subsys/logging/Kconfig.template.log_config"

endif # SENSORS
```
